## boards/arm/feather_nrf52840/Kconfig.board
```kconfig
# Adafruit Feather nRF52840 Express board configuration

# Copyright (c) 2020 Tobias Svehagen
# SPDX-License-Identifier: Apache-2.0

config BOARD_FEATHER_NRF52840
	bool "Adafruit Feather nRF52840 Express"
	depends on SOC_NRF52840_QIAA
```
